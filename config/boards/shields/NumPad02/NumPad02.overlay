/*
 * Copyright (c) 2021 The ZMK Contributors
 *
 * SPDX-License-Identifier: MIT
 */

#include "NumPad02.dtsi"

&default_transform {
    col-offset = <7>;
};

 &kscan0 {
     col-gpios 
         = <&pro_micro 14 GPIO_ACTIVE_HIGH>,  // c4 14
         , <&pro_micro 15 GPIO_ACTIVE_HIGH>,  // c3 15
         , <&pro_micro 18 GPIO_ACTIVE_HIGH>,  // c2 18 A0
         , <&pro_micro 19 GPIO_ACTIVE_HIGH>;  // c1 19 A1

    };
